// font_data.cpp - 修复版
#include "font_data.h"
#include <string.h>
#include <Arduino.h>
// ==================== 完整的5x7字体数据 ====================
// 传统5x7字体格式：每个字符5字节，每字节代表一列
// 每字节的bit6在顶部，bit0在底部（或反过来）

// 只包含菜单需要的字符：G,A,M,E,T,H,U,O,N,S,B,I,1-9,0,/,空格
// 按ASCII顺序排列，从空格(32)开始

// ==================== 完整的5x7 ASCII字体数据 (32-126) ====================
// 标准5x7字体，每个字符5字节，每字节代表一列，bit0在顶部，bit6在底部

static const uint8_t font5x7_complete[] = {
    // 空格 (32) - 索引0
    0x00, 0x00, 0x00, 0x00, 0x00,
    
    // ! (33)
    0x00, 0x00, 0x5F, 0x00, 0x00,
    
    // " (34)
    0x00, 0x07, 0x00, 0x07, 0x00,
    
    // # (35)
    0x14, 0x7F, 0x14, 0x7F, 0x14,
    
    // $ (36)
    0x24, 0x2A, 0x7F, 0x2A, 0x12,
    
    // % (37)
    0x23, 0x13, 0x08, 0x64, 0x62,
    
    // & (38)
    0x36, 0x49, 0x55, 0x22, 0x50,
    
    // ' (39)
    0x00, 0x05, 0x03, 0x00, 0x00,
    
    // ( (40)
    0x00, 0x1C, 0x22, 0x41, 0x00,
    
    // ) (41)
    0x00, 0x41, 0x22, 0x1C, 0x00,
    
    // * (42)
    0x08, 0x2A, 0x1C, 0x2A, 0x08,
    
    // + (43)
    0x08, 0x08, 0x3E, 0x08, 0x08,
    
    // , (44)
    0x00, 0x50, 0x30, 0x00, 0x00,
    
    // - (45)
    0x08, 0x08, 0x08, 0x08, 0x08,
    
    // . (46)
    0x00, 0x60, 0x60, 0x00, 0x00,
    
    // / (47)
    0x20, 0x10, 0x08, 0x04, 0x02,
    
    // 0 (48)
    0x3E, 0x51, 0x49, 0x45, 0x3E,
    
    // 1 (49)
    0x00, 0x42, 0x7F, 0x40, 0x00,
    
    // 2 (50)
    0x42, 0x61, 0x51, 0x49, 0x46,
    
    // 3 (51)
    0x21, 0x41, 0x45, 0x4B, 0x31,
    
    // 4 (52)
    0x18, 0x14, 0x12, 0x7F, 0x10,
    
    // 5 (53)
    0x27, 0x45, 0x45, 0x45, 0x39,
    
    // 6 (54)
    0x3C, 0x4A, 0x49, 0x49, 0x30,
    
    // 7 (55)
    0x01, 0x71, 0x09, 0x05, 0x03,
    
    // 8 (56)
    0x36, 0x49, 0x49, 0x49, 0x36,
    
    // 9 (57)
    0x06, 0x49, 0x49, 0x29, 0x1E,
    
    // : (58)
    0x00, 0x36, 0x36, 0x00, 0x00,
    
    // ; (59)
    0x00, 0x56, 0x36, 0x00, 0x00,
    
    // < (60)
    0x00, 0x08, 0x14, 0x22, 0x41,
    
    // = (61)
    0x14, 0x14, 0x14, 0x14, 0x14,
    
    // > (62)
    0x41, 0x22, 0x14, 0x08, 0x00,
    
    // ? (63)
    0x02, 0x01, 0x51, 0x09, 0x06,
    
    // @ (64)
    0x32, 0x49, 0x79, 0x41, 0x3E,
    
    // 大写字母 A-Z (65-90)
    // A (65)
    0x7E, 0x09, 0x09, 0x09, 0x7E,
    // B (66)
    0x7F, 0x49, 0x49, 0x49, 0x36,
    // C (67)
    0x3E, 0x41, 0x41, 0x41, 0x22,
    // D (68)
    0x7F, 0x41, 0x41, 0x22, 0x1C,
    // E (69)
    0x7F, 0x49, 0x49, 0x49, 0x41,
    // F (70)
    0x7F, 0x09, 0x09, 0x09, 0x01,
    // G (71)
    0x3E, 0x41, 0x49, 0x49, 0x7A,
    // H (72)
    0x7F, 0x08, 0x08, 0x08, 0x7F,
    // I (73)
    0x00, 0x41, 0x7F, 0x41, 0x00,
    // J (74)
    0x20, 0x40, 0x41, 0x3F, 0x01,
    // K (75)
    0x7F, 0x08, 0x14, 0x22, 0x41,
    // L (76)
    0x7F, 0x40, 0x40, 0x40, 0x40,
    // M (77)
    0x7F, 0x02, 0x0C, 0x02, 0x7F,
    // N (78)
    0x7F, 0x04, 0x08, 0x10, 0x7F,
    // O (79)
    0x3E, 0x41, 0x41, 0x41, 0x3E,
    // P (80)
    0x7F, 0x09, 0x09, 0x09, 0x06,
    // Q (81)
    0x3E, 0x41, 0x51, 0x21, 0x5E,
    // R (82)
    0x7F, 0x09, 0x19, 0x29, 0x46,
    // S (83)
    0x46, 0x49, 0x49, 0x49, 0x31,
    // T (84)
    0x01, 0x01, 0x7F, 0x01, 0x01,
    // U (85)
    0x3F, 0x40, 0x40, 0x40, 0x3F,
    // V (86)
    0x1F, 0x20, 0x40, 0x20, 0x1F,
    // W (87)
    0x3F, 0x40, 0x38, 0x40, 0x3F,
    // X (88)
    0x63, 0x14, 0x08, 0x14, 0x63,
    // Y (89)
    0x07, 0x08, 0x70, 0x08, 0x07,
    // Z (90)
    0x61, 0x51, 0x49, 0x45, 0x43,
    
    // [ (91)
    0x00, 0x7F, 0x41, 0x41, 0x00,
    
    // \ (92)
    0x02, 0x04, 0x08, 0x10, 0x20,
    
    // ] (93)
    0x00, 0x41, 0x41, 0x7F, 0x00,
    
    // ^ (94)
    0x04, 0x02, 0x01, 0x02, 0x04,
    
    // _ (95)
    0x40, 0x40, 0x40, 0x40, 0x40,
    
    // ` (96)
    0x00, 0x01, 0x02, 0x04, 0x00,
    
    // 小写字母 a-z (97-122)
    // a (97)
    0x20, 0x54, 0x54, 0x54, 0x78,
    // b (98)
    0x7F, 0x48, 0x44, 0x44, 0x38,
    // c (99)
    0x38, 0x44, 0x44, 0x44, 0x20,
    // d (100)
    0x38, 0x44, 0x44, 0x48, 0x7F,
    // e (101)
    0x38, 0x54, 0x54, 0x54, 0x18,
    // f (102)
    0x08, 0x7E, 0x09, 0x01, 0x02,
    // g (103)
    0x0C, 0x52, 0x52, 0x52, 0x3E,
    // h (104)
    0x7F, 0x08, 0x04, 0x04, 0x78,
    // i (105)
    0x00, 0x44, 0x7D, 0x40, 0x00,
    // j (106)
    0x20, 0x40, 0x44, 0x3D, 0x00,
    // k (107)
    0x7F, 0x10, 0x28, 0x44, 0x00,
    // l (108)
    0x00, 0x41, 0x7F, 0x40, 0x00,
    // m (109)
    0x7C, 0x04, 0x18, 0x04, 0x78,
    // n (110)
    0x7C, 0x08, 0x04, 0x04, 0x78,
    // o (111)
    0x38, 0x44, 0x44, 0x44, 0x38,
    // p (112)
    0x7C, 0x14, 0x14, 0x14, 0x08,
    // q (113)
    0x08, 0x14, 0x14, 0x14, 0x7C,
    // r (114)
    0x7C, 0x08, 0x04, 0x04, 0x08,
    // s (115)
    0x48, 0x54, 0x54, 0x54, 0x20,
    // t (116)
    0x04, 0x3F, 0x44, 0x40, 0x20,
    // u (117)
    0x3C, 0x40, 0x40, 0x20, 0x7C,
    // v (118)
    0x1C, 0x20, 0x40, 0x20, 0x1C,
    // w (119)
    0x3C, 0x40, 0x30, 0x40, 0x3C,
    // x (120)
    0x44, 0x28, 0x10, 0x28, 0x44,
    // y (121)
    0x0C, 0x50, 0x50, 0x50, 0x3C,
    // z (122)
    0x44, 0x64, 0x54, 0x4C, 0x44,
    
    // { (123)
    0x00, 0x08, 0x36, 0x41, 0x00,
    
    // | (124)
    0x00, 0x00, 0x7F, 0x00, 0x00,
    
    // } (125)
    0x00, 0x41, 0x36, 0x08, 0x00,
    
    // ~ (126)
    0x08, 0x04, 0x08, 0x10, 0x08,
};

// 字体信息表
static FontInfo_t font_table[] = {
    { // FONT_DATA_5x7 - 完整ASCII
        .data = font5x7_complete,
        .width = 5,
        .height = 7,
        .first_char = 32,      // 空格
        .last_char = 126,      // ~
        .char_spacing = 1,
        .name = "5x7_complete"
    },
    { // FONT_DATA_7x10 - 简化版
        .data = font5x7_complete,  // 先用5x7数据
        .width = 7,
        .height = 10,
        .first_char = 32,
        .last_char = 126,
        .char_spacing = 1,
        .name = "7x10_simplified"
    },
};
const FontInfo_t* Font_GetInfo(FontDataID_t font_id) {
    if (font_id >= 0 && font_id < FONT_DATA_COUNT) {
        return &font_table[font_id];
    }
    return &font_table[0];
}

bool Font_CharInRange(FontDataID_t font_id, char ch) {
    const FontInfo_t* info = Font_GetInfo(font_id);
    if (!info) return false;
    return (ch >= info->first_char && ch <= info->last_char);
}
const uint8_t* Font_GetCharBitmap(FontDataID_t font_id, char ch, 
                                  uint8_t* width, uint8_t* height) {
    const FontInfo_t* info = Font_GetInfo(font_id);
    if (!info) return NULL;
    
    if (width) *width = info->width;
    if (height) *height = info->height;
    
    // 调试：显示字符信息
    Serial.printf("[FONT] Request char '%c' (%d), range: %d-%d\n", 
                  ch, ch, info->first_char, info->last_char);
    
    // 检查字符是否在范围内
    if (ch < info->first_char || ch > info->last_char) {
        Serial.printf("[FONT] Char %d out of range, using '?'\n", ch);
        ch = '?';  // 显示问号
    }
    
    // 计算字符索引
    int char_index = ch - info->first_char;
    Serial.printf("[FONT] Char index: %d - %d = %d\n", 
                  ch, info->first_char, char_index);
    
    // 5x7字体：每个字符5字节
    int bytes_per_char = 5;
    
    // 计算数据偏移
    int data_offset = char_index * bytes_per_char;
    Serial.printf("[FONT] Data offset: %d * %d = %d\n", 
                  char_index, bytes_per_char, data_offset);
    
    // 检查边界
    int max_offset = sizeof(font5x7_complete) - bytes_per_char;
    if (data_offset < 0 || data_offset > max_offset) {
        Serial.printf("[FONT] ERROR: Offset %d out of range (0-%d)\n", 
                      data_offset, max_offset);
        return NULL;
    }
    
    const uint8_t* bitmap = &info->data[data_offset];
    
    // 调试：显示位图数据
    Serial.printf("[FONT] Bitmap for '%c': ", ch);
    for (int i = 0; i < 5; i++) {
        Serial.printf("%02X ", bitmap[i]);
    }
    Serial.println();
    
    return bitmap;
}
int Font_GetStringWidth(FontDataID_t font_id, const char* str, uint8_t size) {
    if (!str || !*str) return 0;
    
    const FontInfo_t* info = Font_GetInfo(font_id);
    if (!info) return 0;
    
    int total_width = 0;
    const char* p = str;
    int char_count = 0;
    
    while (*p) {
        if (*p != '\n') {
            total_width += info->width * size;
            char_count++;
        }
        p++;
    }
    
    // 添加字符间距
    if (char_count > 0) {
        total_width += (char_count - 1) * info->char_spacing;
    }
    
    return total_width;
}

int Font_GetStringHeight(FontDataID_t font_id, uint8_t size) {
    const FontInfo_t* info = Font_GetInfo(font_id);
    if (!info) return 0;
    
    return info->height * size;
}